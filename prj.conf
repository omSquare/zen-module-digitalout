## CMakeLists.txt
```
cmake_minimum_required(VERSION 3.13.1)

#set(BOARD "atsamd20_xpro")
#set(BOARD "native_posix")

include($ENV{ZEPHYR_BASE}/cmake/app/boilerplate.cmake NO_POLICY_SCOPE)

project(zen-module-digitalout C)

set(CMAKE_C_STANDARD 11)
target_sources(app PRIVATE src/zbus.h)
target_sources_ifdef(CONFIG_SOC_FAMILY_SAM0 app PRIVATE src/main_sam0.c src/zbus_sam0.h src/zbus_sam0.c)
target_sources_ifdef(CONFIG_BOARD_NATIVE_POSIX app PRIVATE src/main.c src/zbus_native_posix.c)
```

## prj.conf
```kconfig
CONFIG_TICKLESS_IDLE=y
CONFIG_TICKLESS_KERNEL=y
CONFIG_CORTEX_M_SYSTICK=n
CONFIG_SAM0_RTC_TIMER=y
CONFIG_USE_SEGGER_RTT=y
CONFIG_LOG=y
CONFIG_LOG_BACKEND_RTT=y
CONFIG_LOG_BACKEND_UART=n
CONFIG_LOG_BACKEND_RTT_MODE_DROP=y
CONFIG_POSIX_API=y
CONFIG_PTHREAD_IPC=y
CONFIG_MAX_PTHREAD_COUNT=0
CONFIG_MAX_TIMER_COUNT=0
CONFIG_UART_INTERRUPT_DRIVEN=n
```

## src/main.c
```c
/*
 * Copyright (c) 2019 omSquare s.r.o.
 *
 * SPDX-License-Identifier: Apache-2.0
 */

#include <logging/log.h>

#include "zbus.h"

LOG_MODULE_REGISTER(main);

int main(void)
{
    LOG_INF("starting");

    struct device *dev = device_get_binding("zbus0");
    struct zbus_config cfg = {
            .udid = {.id = {0, 0, 0, 0, 0, 0, 0, 1}},
    };
    zbus_configure(dev, &cfg);

    for (;;) {
        int err = zbus_connect(dev);
        if (err != 0) {
            LOG_ERR("cound not connect: %d, retrying...", err);
            k_sleep(1000);
            continue;
        }

        u8_t buf[64];
        int n = zbus_recv(dev, buf, sizeof(buf));
        if (n < 0) {
            LOG_ERR("recv error: %d", n);
            continue;
        }

        if (n == 1 && buf[0] == 0xFF) {
            break;
        }

        LOG_INF("recv %d bytes", n);
        for (int i = 0; i < n; i++) {
            buf[i] = (buf[i] >> 4) | (buf[i] << 4);
        }

        n = zbus_send(dev, buf, n);
        if (n < 0) {
            LOG_ERR("send error: %d", n);
            continue;
        }
    }

    LOG_INF("stopping");

#ifdef CONFIG_ARCH_POSIX
    void posix_exit(int);
    posix_exit(0);
#endif
    return 0;
}
```

## src/main_native_posix.c
```c
/*
 * Copyright (c) 2019 omSquare s.r.o.
 *
 * SPDX-License-Identifier: Apache-2.0
 */

#include <logging/log.h>

#include "zbus.h"

LOG_MODULE_REGISTER(main);

int main(void)
{
    LOG_INF("starting");

    LOG_INF("stopping");
    return 0;
}
```

## src/main_sam0.c
```c
#include <zephyr.h>
#include <gpio.h>
#include <pinmux.h>
#include <soc.h>
#include <logging/log.h>

#include "zbus_sam0.h"

#include "zbus.h"

LOG_MODULE_REGISTER(main);

#define LED_PORT LED0_GPIO_CONTROLLER
#define LED LED0_GPIO_PIN

#define CONF_ADDR 0x76
#define POLL_ADDR 0x77

#define I2C (SERCOM5->I2CS)
#define IRQ SERCOM5_IRQn

#define WORKAROUND 0

/////////////////////////////////
// PB16(SDA) PB17(SCL) SERCOM5 //
/////////////////////////////////
/////////////////////////////////
// PA08(SDA) PA09(SCL) SERCOM0 //
/////////////////////////////////
/////////////////////////////////
// PA22(SDA) PA23(SCL) SERCOM5 //
/////////////////////////////////

struct i2c_state {
    bool read_dir;
    bool read_start;

    u8_t read_data;
};

static struct i2c_state i2c_state;

static void isr_i2c_slave(void *);

static inline void i2c_sync(void)
{
    while (I2C.STATUS.reg & SERCOM_I2CS_STATUS_SYNCBUSY) {
        /* Wait for synchronization... */
    }
}

void i2c_reset(void)
{
    i2c_sync();
    I2C.INTENCLR.reg = SERCOM_I2CS_INTENCLR_MASK;
    I2C.INTFLAG.reg = SERCOM_I2CS_INTFLAG_MASK;
    I2C.CTRLA.reg &= ~SERCOM_I2CS_CTRLA_ENABLE;

    i2c_state = (struct i2c_state) {false, false, 0};

    i2c_sync();
    I2C.CTRLA.reg |= SERCOM_I2CS_CTRLA_SWRST;
}

void i2c_init_slave(void)
{
    i2c_sync();
    I2C.CTRLA.reg =
            SERCOM_I2CS_CTRLA_MODE_I2C_SLAVE;// | SERCOM_I2CS_CTRLA_SDAHOLD(0x2);
    // TODO CTRLA LOWTOUT SDAHOLD

    i2c_sync();
//    I2C.CTRLB.reg |= SERCOM_I2CS_CTRLB_AMODE(0) | SERCOM_I2CS_CTRLB_SMEN;
    I2C.CTRLB.reg = SERCOM_I2CS_CTRLB_AMODE(0);
    // TODO CTRLB AMODE SMEN

    i2c_sync();
    I2C.ADDR.reg = SERCOM_I2CS_ADDR_ADDR(CONF_ADDR) | SERCOM_I2CS_ADDR_GENCEN;
    // TODO ADDR ADDRMASK

    NVIC_ClearPendingIRQ(IRQ);
    IRQ_CONNECT(IRQ, 0, isr_i2c_slave, 0, 0);
    irq_enable(IRQ);

    I2C.INTENSET.reg = SERCOM_I2CS_INTENSET_DRDY | SERCOM_I2CS_INTENSET_AMATCH
            | SERCOM_I2CS_INTENSET_PREC;

    i2c_sync();
    I2C.CTRLA.reg |= SERCOM_I2CS_CTRLA_ENABLE;
}

static u8_t last_data;

static int write_requested(u8_t addr)
{
    LOG_INF("wreq %x", addr);
    return 0;
}

static int write_received(u8_t val)
{
//    LOG_INF("wrec %x", val);
    last_data = val;
    return 0;
}

static int read_requested(u8_t addr, u8_t *val)
{
    LOG_INF("rreq %x", addr);
    *val = last_data;
    *val = 0x3A;
    return 0;
}

static int read_processed(u8_t *val)
{
    static u8_t data = 120;
//    LOG_INF("rpro");
    data = data + 1;
//    *val = data | 0x40;
    *val = data;
    *val = 0xAA;
    return 0;
}

static int stop_received(void)
{
    LOG_INF("stop");
    return 0;
}

static int error_received(void)
{
    // TODO(mbenda): error code
    LOG_INF("err");
    return 0;
}

static inline void i2c_set_ackact(bool ack)
{
#if WORKAROUND
    int key = irq_lock();
    I2C.STATUS.reg = 0;

    if (ack) {
        I2C.CTRLB.reg = 0;
    } else {
        I2C.CTRLB.reg = SERCOM_I2CS_CTRLB_ACKACT;
    }
    irq_unlock(key);
#else /* !WORKAROUND */
    if (ack == true) {
        I2C.CTRLB.reg &= ~SERCOM_I2CS_CTRLB_ACKACT;
    } else {
        I2C.CTRLB.reg |= SERCOM_I2CS_CTRLB_ACKACT;
    }
#endif
}

static inline void i2c_amatch_cmd3()
{
#if WORKAROUND
    if (I2C.INTFLAG.bit.PREC) {
        I2C.INTFLAG.reg = SERCOM_I2CS_INTFLAG_PREC;
    }
    I2C.INTFLAG.reg = SERCOM_I2CS_INTFLAG_AMATCH;
#else /* !WORKAROUND */
    I2C.CTRLB.reg = SERCOM_I2CS_CTRLB_CMD(0x3);
#endif
}

static void isr_i2c_slave_amatch(void)
{
    if (I2C.STATUS.reg & (SERCOM_I2CS_STATUS_BUSERR | SERCOM_I2CS_STATUS_COLL
            | SERCOM_I2CS_STATUS_LOWTOUT)) {
        /* A bus error occurred. */
        error_received();
    }

    u8_t addr = I2C.DATA.reg >> 1;
    int err;

    i2c_state.read_dir = I2C.STATUS.reg & SERCOM_I2CS_STATUS_DIR;
    if (i2c_state.read_dir) {
        /* Master read requested. */
        err = read_requested(addr, &i2c_state.read_data);
        if (!err) {
            i2c_state.read_start = true;
        }

    } else {
        /* Master write requested. */
        err = write_requested(addr);
    }

    /* ACK or NAK the address. */
    i2c_set_ackact(err == 0);
    i2c_amatch_cmd3();

    i2c_set_ackact(true);
}

static void isr_i2c_slave_drdy(void)
{
    int err;

    if (i2c_state.read_dir) {
        /* Master read data. */
        if (i2c_state.read_start) {
            /* Send the first byte. */
            I2C.DATA.reg = i2c_state.read_data;
            i2c_state.read_start = false;
            err = 0;
        } else if ((I2C.STATUS.reg & SERCOM_I2CS_STATUS_RXNACK)) {
            /* Master NAK. */
//            error_received();
            err = EIO; // TODO EOF
        } else {
            /* Ask for a byte to send. */
            u8_t data;
            err = read_processed(&data);
            if (!err) {
                I2C.DATA.reg = data;
            }
        }
    } else {
        /* Master write data. */
        u8_t data = I2C.DATA.reg;
        err = write_received(data);
    }

    if (err) {
        /* Terminate the transfer */
        i2c_set_ackact(false);
        I2C.CTRLB.reg |= SERCOM_I2CS_CTRLB_CMD(0x2);
    } else {
        /* Continue in the transfer. */
        I2C.CTRLB.reg |= SERCOM_I2CS_CTRLB_CMD(0x3);
    }
}

static void isr_i2c_slave(void *arg)
{
    ARG_UNUSED(arg);

    /* Read interrupt flags. */
    u8_t status = I2C.INTFLAG.reg & I2C.INTENSET.reg;

    if (status & SERCOM_I2CS_INTFLAG_AMATCH) {
        isr_i2c_slave_amatch();
    } else if (status & SERCOM_I2CS_INTFLAG_DRDY) {
        isr_i2c_slave_drdy();
    } else if (status & SERCOM_I2CS_INTFLAG_PREC) {
        /* Stop received. */
        stop_received();
        I2C.INTFLAG.reg = SERCOM_I2CS_INTFLAG_PREC;
    }
}

static volatile int active;

int p = 20;

void main(void)
{
    LOG_INF("I²C slave test");

    struct device *port = device_get_binding(LED_PORT);

    gpio_pin_configure(port, LED, GPIO_DIR_OUT);
    gpio_pin_write(port, LED, 1);

    struct device *muxa = device_get_binding("PINMUX_A");
    struct device *muxb = device_get_binding("PINMUX_B");

//    pinmux_pin_set(muxb, 16, PINMUX_FUNC_C);
//    pinmux_pin_set(muxb, 17, PINMUX_FUNC_C);
//    pinmux_pin_set(muxa, 8, PINMUX_FUNC_C);
//    pinmux_pin_set(muxa, 9, PINMUX_FUNC_C);
    pinmux_pin_set(muxa, 22, PINMUX_FUNC_D);
    pinmux_pin_set(muxa, 23, PINMUX_FUNC_D);
    // TODO pull up?

    /* Set up bus clock and GCLK generator. */
    PM->APBCMASK.reg |= PM_APBCMASK_SERCOM5;

    GCLK->CLKCTRL.reg = GCLK_CLKCTRL_ID(SERCOM5_GCLK_ID_CORE)
            | GCLK_CLKCTRL_CLKEN
            | GCLK_CLKCTRL_GEN(0);

    while (GCLK->STATUS.bit.SYNCBUSY) {
        /* Synchronize GCLK. */
    }

    GCLK->CLKCTRL.reg = GCLK_CLKCTRL_ID(SERCOM5_GCLK_ID_SLOW)
            | GCLK_CLKCTRL_CLKEN
            | GCLK_CLKCTRL_GEN(1);

    while (GCLK->STATUS.bit.SYNCBUSY) {
        /* Synchronize GCLK. */
    }

//    i2c_reset();
//
//    i2c_init_slave();
//
//    while (true) {
//        gpio_pin_write(port, LED, active);
//        k_sleep(200 * p / 20);
//        gpio_pin_write(port, LED, 1);
//        k_sleep(200 * p / 20);
//        gpio_pin_write(port, LED, active);
//        k_sleep(200 * p / 20);
//        gpio_pin_write(port, LED, 1);
//        k_sleep(800 * p / 20);
////        LOG_INF("baf %d!", p);
//        p--;
//        if (p < 0) {
//            p = 20;
//        }
//    }

    zbus_init_old(&(struct zbus_cfg) {
            .udid = {0x01, 0x02, 0x03, 0x04, 0x05, 0x06, 0x07, 0x08},
    });

    u8_t pkt[ZBUS_MAX_DATA];

    while (true) {
        int ret = zbus_recv_old(pkt, sizeof(pkt));
        LOG_INF("recv: %d", ret);
    }
}
```

## src/zbus.c
```c
/*
 * Copyright (c) 2018 omSquare s.r.o.
 *
 * SPDX-License-Identifier: Apache-2.0
 */

#include "zbus.h"

#include <device.h>
#include <soc.h>
#include <gpio.h>
#include <posix/pthread.h>
#include <logging/log.h>

LOG_MODULE_REGISTER(zbus, LOG_LEVEL_DBG);

// "configuration" address
#define CONF_ADDR 0x76

// "data poll" address
#define POLL_ADDR 0x77

#define SERCOM(n) SERCOM_EVAL(n)
#define SERCOM_EVAL(n) SERCOM##n

#define IRQ (SERCOM0_IRQn + CONFIG_ZBUS_SERCOM)
#define I2C (&SERCOM(CONFIG_ZBUS_SERCOM)->I2CS)

static struct {
    // the state of the bus
    enum zbus_state state;

    // address (0 when not in ZBUS_RDY state)
    s8_t addr;

    // packet receiving
    u8_t* rx_data;
    u8_t rx_len;

    // packet sending
    const u8_t *tx_data;
    u8_t tx_len;

    // peripherals
    struct device *alert_port;
    bool i2c_read;
    s8_t i2c_addr;

    // buffer
    u8_t buf[ZBUS_MAX_DATA];
    int buf_len;
    int buf_pos;
    s8_t buf_addr;

    // TODO(mbenda): stats, error counters...
} zbus;

static struct {
    void *fifo_header;
    volatile int ev;
} zbus_event;

#define EV_DONE_RX  0x01
#define EV_DONE_TX  0x02
#define EV_ERR_DATA 0x04
#define EV_ERR_BUS  0x08

static void zbus_worker(void *, void *, void *);
static void i2c_reset(void);
static void i2c_enable_conf(void);
static void i2c_isr(void *arg);

K_FIFO_DEFINE(zbus_fifo);

// TX buffer for POLL replies
u8_t zbus_poll_buf[2];

// TX buffer for CONF replies
u8_t zbus_conf_buf[8];

// RX buffer for bus requests
u8_t zbus_rx_buf[9];

static PTHREAD_MUTEX_DEFINE(zbus_lock);
static PTHREAD_COND_DEFINE(zbus_recv_cond);
static PTHREAD_COND_DEFINE(zbus_send_cond);

K_THREAD_DEFINE(zbus_thread, 1024, zbus_worker, NULL, NULL, NULL, -1, 0,
        K_NO_WAIT);

// ----------------------------------------------------------------------
// Zbus API
// ----------------------------------------------------------------------

int zbus_init(struct zbus_config *cfg)
{
    // TODO(mbenda): initialize conf buffer

    // configure alert pin
    zbus.alert_port = device_get_binding(CONFIG_ZBUS_ALERT_PORT);
    if (zbus.alert_port == NULL) {
        return -ENODEV;
    }

    gpio_pin_configure(zbus.alert_port, CONFIG_ZBUS_ALERT_PIN,
            GPIO_DIR_OUT | GPIO_PUD_PULL_UP);

    // configure SERCOM I²C
    PM->APBCMASK.reg |= PM_APBCMASK_SERCOM0 << CONFIG_ZBUS_SERCOM;

    IRQ_DIRECT_CONNECT(IRQ, 0, i2c_isr, 0);

    zbus_reset();

    return 0;
}

int zbus_recv(void *buf, int size)
{
    pthread_mutex_lock(&zbus_lock);

    while (zbus.tx_data != NULL) {
        // wait for other transfers to complete
        pthread_cond_wait(&zbus_recv_cond, &zbus_lock);
    }

    // set rx data atomically
    int key = irq_lock();

    zbus.rx_data = buf;
    zbus.rx_len = (u8_t) (size > ZBUS_MAX_DATA ? ZBUS_MAX_DATA : size);

    irq_unlock(key);

    // wait for transfer to complete
    pthread_cond_wait(&zbus_send_cond, &zbus_lock);

    // TODO(mbenda): return value
    pthread_mutex_unlock(&zbus_lock);
    return 0;
}

int zbus_send(const void *buf, int size)
{
    pthread_mutex_lock(&zbus_lock);

    while (zbus.tx_data != NULL) {
        // wait for other transfers to complete
        pthread_cond_wait(&zbus_send_cond, &zbus_lock);
    }

    // set tx data atomically
    int key = irq_lock();

    zbus.tx_data = buf;
    zbus.tx_len = (u8_t) (size > ZBUS_MAX_DATA ? ZBUS_MAX_DATA : size);

    irq_unlock(key);

    // wait for transfer to complete
    pthread_cond_wait(&zbus_send_cond, &zbus_lock);

    // TODO(mbenda): return value
    pthread_mutex_unlock(&zbus_lock);
    return 0;
}

int zbus_reset(void)
{
    pthread_mutex_lock(&zbus_lock);

    // move to the "conf" state
    zbus.state = ZBUS_CONF;

    // reset I²C and alert pin
    i2c_reset();
    gpio_pin_write(zbus.alert_port, CONFIG_ZBUS_ALERT_PIN, 1);

    // stop any ongoing transfers
    pthread_cond_broadcast(&zbus_recv_cond);
    pthread_cond_broadcast(&zbus_send_cond);
    // TODO(mbenda): buffers

    zbus.addr = -1;

    // configure I²C
    i2c_enable_conf();

    pthread_mutex_unlock(&zbus_lock);
    return 0;
}

bool zbus_is_ready(void)
{
    return zbus.state == ZBUS_READY;
}

// ----------------------------------------------------------------------
// SERCOM I²C bus
// ----------------------------------------------------------------------

// TODO(mbenda): are all sync necessary?

static inline void i2c_sync(void)
{
    while (I2C->STATUS.reg & SERCOM_I2CS_STATUS_SYNCBUSY) {
        // wait for synchronization...
    }
}

static inline void i2c_set_ackact(bool ack)
{
#ifdef CONFIG_I2C_SAM0_WORKAROUND
    int key = irq_lock();
    I2C->STATUS.reg = 0;

    if (ack) {
        I2C->CTRLB.reg = 0;
    } else {
        I2C->CTRLB.reg = SERCOM_I2CS_CTRLB_ACKACT;
    }
    irq_unlock(key);
#else /* !CONFIG_I2C_SAM0_WORKAROUND */
    if (ack == true) {
        I2C->CTRLB.reg &= ~SERCOM_I2CS_CTRLB_ACKACT;
    } else {
        I2C->CTRLB.reg |= SERCOM_I2CS_CTRLB_ACKACT;
    }
#endif
}

static inline void i2c_amatch_cmd3()
{
#ifdef CONFIG_I2C_SAM0_WORKAROUND
    if (I2C->INTFLAG.bit.PREC) {
        I2C->INTFLAG.reg = SERCOM_I2CS_INTFLAG_PREC;
    }
    I2C->INTFLAG.reg = SERCOM_I2CS_INTFLAG_AMATCH;
#else /* !CONFIG_I2C_SAM0_WORKAROUND */
    I2C->CTRLB.reg = SERCOM_I2CS_CTRLB_CMD(0x3);
#endif
}

static inline void i2c_init_buf(void *buf, int size)
{
    memcpy(zbus.buf, buf, (size_t) size);
    zbus.buf_pos = 0;
    zbus.buf_len = size;
}

static inline int i2c_notify(int ev)
{
    if (zbus_event.ev) {
        // event not consumed yet
        LOG_ERR("PANIC!");
//        k_panic(); // FIXME
        return -1;
    }

    zbus_event.ev = ev;

    k_fifo_put(&zbus_fifo, &zbus_event);
    return 0;
}

static void i2c_disable(void)
{
    I2C->INTENCLR.reg = SERCOM_I2CS_INTENCLR_MASK;
    I2C->INTFLAG.reg = SERCOM_I2CS_INTFLAG_MASK;

//    NVIC_ClearPendingIRQ(IRQ);
    irq_disable(IRQ);

    i2c_sync();
    I2C->CTRLA.reg &= ~SERCOM_I2CS_CTRLA_ENABLE;
}

void i2c_reset(void)
{
    i2c_disable();

    i2c_sync();
    I2C->CTRLA.reg |= SERCOM_I2CS_CTRLA_SWRST;
}

void i2c_enable_conf(void)
{
    i2c_sync();
    I2C->CTRLA.reg = SERCOM_I2CS_CTRLA_MODE_I2C_SLAVE;
    // TODO CTRLA LOWTOUT SDAHOLD

    i2c_sync();
    I2C->CTRLB.reg = SERCOM_I2CS_CTRLB_AMODE(0x00) | SERCOM_I2CS_CTRLB_SMEN;

    i2c_sync();
    I2C->ADDR.reg =
            SERCOM_I2CS_ADDR_ADDR(CONF_ADDR) | SERCOM_I2CS_ADDR_GENCEN;

    i2c_sync();
    I2C->CTRLA.reg |= SERCOM_I2CS_CTRLA_ENABLE;
    I2C->INTENSET.reg = SERCOM_I2CS_INTENSET_AMATCH;

    irq_enable(IRQ);
}

void i2c_enable_ready(void)
{
    // disable I²C first
    i2c_disable();

    // reconfigure address matching
    i2c_sync();
    I2C->CTRLB.reg = SERCOM_I2CS_CTRLB_AMODE(0x01) | SERCOM_I2CS_CTRLB_SMEN;

    i2c_sync();
    I2C->ADDR.reg =
            SERCOM_I2CS_ADDR_ADDR(zbus.addr) | SERCOM_I2CS_ADDR_GENCEN
                    | SERCOM_I2CS_ADDR_ADDRMASK(POLL_ADDR);

    i2c_sync();
    I2C->INTENSET.reg = SERCOM_I2CS_INTENSET_AMATCH;
    I2C->CTRLA.reg |= SERCOM_I2CS_CTRLA_ENABLE;

    irq_enable(IRQ);
}

void i2c_amatch(void)
{
    // address match
    int ev = 0;

    if (I2C->STATUS.reg & (SERCOM_I2CS_STATUS_BUSERR
            | SERCOM_I2CS_STATUS_COLL | SERCOM_I2CS_STATUS_LOWTOUT)) {
        // a bus error occurred
        ev |= EV_ERR_BUS;
    }

    // get the address and check direction
    u8_t addr = I2C->DATA.reg >> 1;
    bool nak = false;

    // TODO(mbenda): check buf readiness?

    if (I2C->STATUS.reg & SERCOM_I2CS_STATUS_DIR) {
        // master reads data
        zbus.i2c_read = true;

        if (addr == zbus.addr) {
            // data read
            if (zbus.tx_data == NULL) {
                // no data to send
                ev |= EV_ERR_DATA;
                nak = true;
            } else {
                i2c_init_buf((void *) zbus.tx_data, zbus.tx_len);
            }
        } else if (addr == CONF_ADDR) {
            // configuration read
            i2c_init_buf(zbus_conf_buf, sizeof(zbus_conf_buf));
        } else if (addr == POLL_ADDR) {
            // poll read
            if (zbus.rx_data == NULL) {
                // nothing to send
                nak = true;
            } else {
                zbus.buf[0] = (u8_t) zbus.addr;
                zbus.buf[1] = (u8_t) zbus.tx_len;
                zbus.buf_pos = 0;
                zbus.buf_len = 2;
            }
        } else {
            // NAK the address
            nak = true;
        }
    } else {
        // master writes data
        zbus.i2c_read = false;
        zbus.i2c_addr = addr;

        if (addr == zbus.addr) {
            // data write
            // TODO(mbenda): implement this
        } else if (addr == 0) {
            // general call (command)
            i2c_init_buf(zbus_rx_buf, 1);
        } else if (addr == CONF_ADDR) {
            // configuration write
            i2c_init_buf(zbus_rx_buf, 8);
        } else {
            nak = true;
        }
    }

    // ACK/NAK the address
    if (nak) {
        i2c_set_ackact(false);
    } else {
        i2c_set_ackact(true);
        I2C->INTENSET.reg = SERCOM_I2CS_INTENSET_DRDY
                | SERCOM_I2CS_INTENSET_PREC;
    }

    i2c_amatch_cmd3();
    i2c_set_ackact(true);

    if (ev) {
        i2c_notify(ev);
    }
}

void i2c_drdy(void)
{
    // data ready
    bool nak = false;

    if (zbus.i2c_read) {
        // master is reading, send another byte
        if (zbus.buf_pos > 0 && (I2C->STATUS.reg & SERCOM_I2CS_STATUS_RXNACK)) {
            // master NAK
            nak = true;
        } else if (zbus.buf_pos >= zbus.buf_len) {
            // buffer underflow
            nak = true;
        } else {
            I2C->DATA.reg = zbus.buf[zbus.buf_pos++];
        }
    } else {
        // master is writing, receive another byte
        if (zbus.buf_pos >= zbus.buf_len) {
            // buffer overflow
            nak = true;
        } else {
            zbus.buf[zbus.buf_pos++] = I2C->DATA.reg;
        }
    }

    if (nak) {
        // terminate the transfer
        i2c_set_ackact(false);
        I2C->CTRLB.reg |= SERCOM_I2CS_CTRLB_CMD(0x2);
        I2C->INTENCLR.reg = SERCOM_I2CS_INTENSET_DRDY
                | SERCOM_I2CS_INTENSET_PREC;

        // TODO(mbenda): store error and send it with "done" event?
        i2c_notify(EV_ERR_DATA);
    }
}

void i2c_prec(void)
{
    // stop received
    I2C->INTFLAG.reg = SERCOM_I2CS_INTFLAG_PREC;
    I2C->INTENCLR.reg = SERCOM_I2CS_INTENSET_DRDY
            | SERCOM_I2CS_INTENSET_PREC;

    zbus.buf_addr = zbus.i2c_addr;
    i2c_notify(zbus.i2c_read ? EV_DONE_TX : EV_DONE_RX);
}

void i2c_isr(void *arg)
{
    ARG_UNUSED(arg);

    // read interrupt flags
    u8_t status = I2C->INTFLAG.reg & I2C->INTENSET.reg;

    if (status & SERCOM_I2CS_INTFLAG_AMATCH) {
        i2c_amatch();
    } else if (status & SERCOM_I2CS_INTFLAG_DRDY) {
        i2c_drdy();
    } else if (status & SERCOM_I2CS_INTFLAG_PREC) {
        i2c_prec();
    }
}

// ----------------------------------------------------------------------
// Zbus process
// ----------------------------------------------------------------------

static void zbus_worker(void *p1, void *p2, void *p3)
{
    ARG_UNUSED(p1);
    ARG_UNUSED(p2);
    ARG_UNUSED(p3);

    LOG_INF("worker started");

    while (true) {
        // read next event
        k_fifo_get(&zbus_fifo, K_FOREVER);
        int ev = zbus_event.ev;
        zbus_event.ev = 0;

        LOG_DBG("processing event %x", ev);

        pthread_mutex_lock(&zbus_lock);

        if (ev & EV_DONE_RX) {
            switch (zbus.buf_addr) {
            case 0:
                // reset
                // TODO(mbenda): check command
                LOG_DBG("reset requested");
                zbus_reset();
                break;

            case CONF_ADDR:
                // address configuration
                LOG_DBG("address configuration received");
                zbus.addr = zbus.buf_addr; // FIXME check UDID and set address
                i2c_enable_ready();
                break;

            default:
                if (zbus.buf_addr == zbus.addr) {
                    // data or ping received
                    LOG_INF("data packet received, len=%d", zbus.buf_len);
                    pthread_cond_broadcast(&zbus_recv_cond);
                } else {
                    LOG_ERR("unexpected RX addr: %x", zbus.buf_addr);
                }
                break;
            }
        }

        if (ev & EV_DONE_TX) {
            switch (zbus.buf_addr) {
            case POLL_ADDR:
                // poll answered
                LOG_DBG("data poll reply sent");
                break;

            case CONF_ADDR:
                // discovery answered
                LOG_DBG("discovery reply sent");
                break;

            default:
                if (zbus.buf_addr == zbus.addr) {
                    // data sent
                    LOG_DBG("data packet sent, len=%d", zbus.buf_len);
                    pthread_cond_broadcast(&zbus_send_cond);
                } else {
                    LOG_ERR("unexpected TX addr: %x", zbus.buf_addr);
                }
                break;
            }
        }

        pthread_mutex_unlock(&zbus_lock);
    }
}
```

## src/zbus.h
```c
/*
 * Copyright (c) 2019 omSquare s.r.o.
 *
 * SPDX-License-Identifier: Apache-2.0
 */

#pragma once

#include <device.h>

// // // //
//  API  //
// // // //

/** The maximum size of a Zbus data packet. */
#define ZBUS_MAX_PACKET_LEN 255

typedef s8_t zbus_addr;

struct zbus_udid {
    u8_t id[8];
};

struct zbus_config {
    // UDID
    struct zbus_udid udid;

    // TODO(mbenda): flags, device class etc.
};

struct zbus_driver_api {
    int (*configure)(struct device *dev, const struct zbus_config *cfg);
    int (*connect)(struct device *dev);
    int (*send)(struct device *dev, const void *buf, int size);
    int (*recv)(struct device *dev, void *buf, int size);
};

/**
 * Initializes the Zbus driver. Disconnects it if it is connected.
 *
 * @param dev the Zbus device
 * @param cfg the Zbus configuration
 * @return 0 on success, -errno on failure
 */
static inline
int zbus_configure(struct device *dev, const struct zbus_config *cfg)
{
    return ((struct zbus_driver_api *) dev->driver_api)->configure(dev, cfg);
}

/**
 * Ensures that the slave is connected to a master and properly configured. Does
 * nothing if already connected and configured.
 *
 * @param dev the Zbus device
 * @return
 */
static inline
int zbus_connect(struct device *dev)
{
    return ((struct zbus_driver_api *) dev->driver_api)->connect(dev);
}

/**
 * Sends the specified data to the master.
 *
 * @param dev the Zbus device
 * @param buf data buffer to send
 * @param size size of the buffer
 * @return 0 on success, -errno on failure
 */
static inline
int zbus_send(struct device *dev, const void *buf, int size)
{
    return ((struct zbus_driver_api *) dev->driver_api)->send(dev, buf, size);
}

/**
 * Receives a data packet from the master.
 *
 * @param dev the Zbus device
 * @param buf data buffer to store received bytes
 * @param size size of the buffer
 * @return number of received bytes on success, -errno on failure
 */
static inline
int zbus_recv(struct device *dev, void *buf, int size)
{
    return ((struct zbus_driver_api *) dev->driver_api)->recv(dev, buf, size);
}
```

## src/zbus_native_posix.c
```c
/*
 * Copyright (c) 2019 omSquare s.r.o.
 *
 * SPDX-License-Identifier: Apache-2.0
 */

#include <stdio.h>
#include <stdlib.h>

#include <memory.h>
#include <netdb.h>
#include <unistd.h>

#include <logging/log.h>
#include <soc.h>

#include "zbus.h"

LOG_MODULE_REGISTER(zbus);

#define ZBUS_MAGIC   0x7082
#define ZBUS_VERSION 0x0000

#define CMD_PACKET 0x00
#define CMD_CONF   0x01
#define CMD_QUIT   0xFF

struct zbus_np_data {
    struct zbus_udid udid;

    zbus_addr addr;
    int sock_fd;
};

struct zbus_np_config {
    char *host;
    u16_t port;
};

// ----------------------------------------------------------------------
// driver API implementation
// ----------------------------------------------------------------------

static int zbus_np_init(struct device *dev)
{
    // nothing to do
    return 0;
}

static int zbus_np_configure(struct device *dev, const struct zbus_config *cfg)
{
    struct zbus_np_data *data = dev->driver_data;
    data->udid = cfg->udid;

    return 0;
}

static int zbus_np_connect(struct device *dev)
{
    struct zbus_np_data *data = dev->driver_data;
    if (data->sock_fd >= 0) {
        // already connected
        return 0;
    }

    // connect to the Zbus simulator
    const struct zbus_np_config *cfg = dev->config->config_info;
    LOG_DBG("connecting to %s:%d", cfg->host, cfg->port);

    struct hostent *host = gethostbyname(cfg->host);
    if (!host) {
        return -ENOENT;
    }

    struct sockaddr_in addr;
    memset(&addr, 0, sizeof(addr));
    addr.sin_family = AF_INET;
    addr.sin_port = htons(cfg->port);
    addr.sin_addr = *((struct in_addr *) host->h_addr_list[0]);

    int fd = socket(AF_INET, SOCK_STREAM, 0);
    if (fd == -1) {
        return -errno;
    }

    if (connect(fd, (struct sockaddr *) &addr, sizeof(addr)) < 0) {
        return -errno;
    }

    // perform handshake
    u16_t header[2] = {htons(ZBUS_MAGIC), htons(ZBUS_VERSION)};
    if (send(fd, header, sizeof(header), 0) < sizeof(header)) {
        return -errno;
    }

    if (recv(fd, header, sizeof(header), MSG_WAITALL) < sizeof(header)) {
        return -errno;
    }

    // check magic and version
    if (ntohs(header[0]) != ZBUS_MAGIC) {
        return -EPROTO;
    }

    if ((ntohs(header[1]) & 0xFF00) != (ZBUS_VERSION & 0xFF00)) {
        return -EPROTONOSUPPORT;
    }

    // write UDID and read address
    if (send(fd, data, sizeof(data->udid), 0) == -1) {
        return -errno;
    }

    u8_t cmd[2];
    if (recv(fd, cmd, sizeof(cmd), MSG_WAITALL) < sizeof(cmd)) {
        return -errno;
    }

    switch (cmd[0]) {
        case CMD_QUIT:
            return -ENOTCONN;

        case CMD_CONF:
            // finally connected
            data->addr = cmd[1];
            data->sock_fd = fd;
            return 0;

        default:
            return -EPROTO;
    }
}

static void zbus_np_disconnect(struct zbus_np_data *data)
{
    if (data->sock_fd >= 0) {
        close(data->sock_fd);
    }

    memset(data, 0, sizeof(struct zbus_np_data));
    data->sock_fd = -1;
}

static int zbus_np_send(struct device *dev, const void *buf, int size)
{
    if (size < 0 || size > ZBUS_MAX_PACKET_LEN) {
        return -EINVAL;
    }

    struct zbus_np_data *data = dev->driver_data;
    if (data->sock_fd < 0) {
        // not connected
        return -ENOTCONN;
    }

    u8_t header[2] = {CMD_PACKET, (u8_t) size};
    if (send(data->sock_fd, header, sizeof(header), 0) < sizeof(header)) {
        zbus_np_disconnect(data);
        return -errno;
    }

    if (send(data->sock_fd, buf, (size_t) size, 0) < size) {
        zbus_np_disconnect(data);
        return -errno;
    }

    return 0;
}

static int zbus_np_recv(struct device *dev, void *buf, int size)
{
    if (size < 0 || size > ZBUS_MAX_PACKET_LEN) {
        return -EINVAL;
    }

    struct zbus_np_data *data = dev->driver_data;
    if (data->sock_fd < 0) {
        // not connected
        return -ENOTCONN;
    }

    u8_t header[2];
    if (recv(data->sock_fd, header, sizeof(header), MSG_WAITALL) != sizeof(header)) {
        zbus_np_disconnect(data);
        return -errno;
    }

    switch (header[0]) {
        case CMD_QUIT:
            zbus_np_disconnect(data);
            return -ENOTCONN;

        case CMD_PACKET:
            // continue to receive the packet payload
            break;

        default:
            zbus_np_disconnect(data);
            return -EPROTO;
    }

    size_t len = (size_t) (header[1] > size ? size : header[1]);
    if (recv(data->sock_fd, buf, len, MSG_WAITALL) != len) {
        zbus_np_disconnect(data);
        return -errno;
    }

    return len;
}

static const struct zbus_driver_api zbus_np_driver_api = {
        .configure = zbus_np_configure,
        .connect = zbus_np_connect,
        .send = zbus_np_send,
        .recv = zbus_np_recv,
};

// ----------------------------------------------------------------------
// device instances
// ----------------------------------------------------------------------

static const struct zbus_np_config zbus_np_cfg0 = {
        .host = "localhost",
        .port = 7802,
};

static struct zbus_np_data zbus_np_data0 = {
        .sock_fd = -1,
};

DEVICE_AND_API_INIT(uart_native_posix0, "zbus0", zbus_np_init,
                    &zbus_np_data0, &zbus_np_cfg0, APPLICATION,
                    CONFIG_KERNEL_INIT_PRIORITY_DEVICE, &zbus_np_driver_api);

// ----------------------------------------------------------------------
// cleanup
// ----------------------------------------------------------------------

static void zbus_np_cleanup(void)
{
    zbus_np_disconnect(&zbus_np_data0);
}

NATIVE_TASK(zbus_np_cleanup, ON_EXIT, 99);
```

## src/zbus_sam0.h
```c
/*
 * Copyright (c) 2018 omSquare s.r.o.
 *
 * SPDX-License-Identifier: Apache-2.0
 */

#pragma once

#include <zephyr.h>

#include "zbus.h"

/**
 * Configuration.
 */
#define CONFIG_ZBUS_SERCOM 5
#define CONFIG_ZBUS_ALERT_PORT "PORTA"
#define CONFIG_ZBUS_ALERT_PIN 21
#define CONFIG_I2C_SAM0_WORKAROUND 1

/** The maximum size of a Zbus data packet. */
#define ZBUS_MAX_DATA 128

/**
 * Enumeration of all possible Zbus states.
 */
enum zbus_state {
    ZBUS_OFF,   // The initial state before zbus_init is called.
    ZBUS_CONF,  // The configuration phase.
    ZBUS_READY, // The ready state when data packets can be sent and received.
};

/**
 * The configuration of a Zbus device.
 */
struct zbus_cfg {
    // UDID
    u8_t udid[8];
    // TODO(mbenda): other device attributes (flags, vendor, type)
};

/**
 * Initializes the bus.
 *
 * @param bus
 * @return
 */
int zbus_init_old(struct zbus_cfg *cfg);

/**
 * Receives a data packet from the master.
 *
 * @param buf data buffer to store received bytes
 * @param size size of the buffer
 * @return number of received bytes on success, -errno on failure
 */
int zbus_recv_old(void *buf, int size); // blocks

/**
 * Sends the specified data to the master.
 *
 * @param buf data buffer to send
 * @param size size of the buffer
 * @return 0 on success, -errno on failure
 */
int zbus_send_old(const void *buf, int size); // blocks

/**
 * Resets the state of the bus and starts its configuration phase.
 *
 * @return 0 on success, -errno on failure
 */
int zbus_reset_old(void);

/**
 * Checks if the bus is ready.
 *
 * @return true if ready, false if not (off or configuring)
 */
bool zbus_is_ready_old(void);
```
